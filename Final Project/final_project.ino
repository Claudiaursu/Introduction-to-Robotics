#include<Wire.h>
#include<PCM.h>
#include<Math.h>

const unsigned char sound1[] PROGMEM = {
 129, 129, 128, 129, 127, 127, 128, 125, 127, 128, 126, 128,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 130, 
}; //the encoded sound for the first stick 
const unsigned char sound2[] PROGMEM = {
 126, 126, 127, 127, 127, 128, 128, 129, 130, 128, 128, 128,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 128, 
}; // the encoded sound for the second stick

const int MPU1 = 0x68;  // I2C address of the first MPU
const int MPU2 = 0x69;  // I2C address of the second MPU
int16_t stick1X, stick1Y, stick1Z;
int16_t stick2X, stick2Y, stick2Z;

bool enaughSpeed = false;
bool isPlayingSound = false;
int soundDuration = 250;
long startSound;

void getStick1Values(const int MPU) {
  Wire.beginTransmission(MPU);
  Wire.write(0x3B);  // starting with register 0x3B (ACCEL_XOUT_H)
  Wire.endTransmission(false);
  Wire.requestFrom(MPU,14,true);

  stick1X = Wire.read()<<8|Wire.read();     
  stick1Y = Wire.read()<<8|Wire.read();  
  stick1Z = Wire.read()<<8|Wire.read(); 

  Serial.print("s1X = "); Serial.print(stick1X);
  Serial.print(" | s1Y = "); Serial.print(stick1Y);
  Serial.print(" | s1Z = "); Serial.println(stick1Z);
}


void getStick2Values(const int MPU) {
  Wire.beginTransmission(MPU);
  Wire.write(0x3B);  // starting with register 0x3B (ACCEL_XOUT_H)
  Wire.endTransmission(false);
  Wire.requestFrom(MPU,14,true);

  stick2X = Wire.read()<<8|Wire.read();     
  stick2Y = Wire.read()<<8|Wire.read();  
  stick2Z = Wire.read()<<8|Wire.read(); 

  Serial.print("s2X = "); Serial.print(stick2X);
  Serial.print(" | s2Y = "); Serial.print(stick2Y);
  Serial.print(" | s2Z = "); Serial.println(stick2Z);
}

void checkToSing1(int16_t lastX){ 
  //this function detects whether a short movement has been made by the first stick, and if true, it starts playing the sound for this stick
  int16_t oldStick1X = stick1X;
  int16_t oldStick1Y = stick1Y;
  int16_t oldStick1Z = stick1Z;

  getStick1Values(MPU1);

  double dist = sqrt(pow(oldStick1X - stick1X, 2) + pow(oldStick1Y - stick1Y, 2) + pow(oldStick1Z - stick1Z, 2));

  if (isPlayingSound && millis() - startSound > soundDuration) {
    isPlayingSound = false;
  }

  if (dist > 22000 && !isPlayingSound) {
    enaughSpeed = true;
  }

  if (dist < 2000 && enaughSpeed) {
    enaughSpeed = false;
    startPlayback(sound1, sizeof(sound1));
    isPlayingSound = true;
    startSound = millis();
    Serial.println("knock");
  }
 
}

void checkToSing2(int16_t lastX){
  //this function detects whether a short movement has been made by the second stick, and if true, it starts playing the sound for this stick
  int16_t oldStick2X = stick2X;
  int16_t oldStick2Y = stick2Y;
  int16_t oldStick2Z = stick2Z;

  getStick2Values(MPU2);

  double dist = sqrt(pow(oldStick2X - stick2X, 2) + pow(oldStick2Y - stick2Y, 2) + pow(oldStick2Z - stick2Z, 2));

  if (isPlayingSound && millis() - startSound > soundDuration) {
    isPlayingSound = false;
  }

  if (dist > 22000 && !isPlayingSound) {
    enaughSpeed = true;
  }

  if (dist < 2000 && enaughSpeed) {
    enaughSpeed = false;
    startPlayback(sound2, sizeof(sound2));
    isPlayingSound = true;
    startSound = millis();
    Serial.println("knock");
  }
 
}

void setup(){
 //setup code to start the first MPU accelerometer
  Wire.begin();
  Wire.beginTransmission(MPU1);
  Wire.write(0x6B);  
  Wire.write(0);    
  Wire.endTransmission(true);

 //setup code to start the second MPU accelerometer
  Wire.begin();
  Wire.beginTransmission(MPU2);
  Wire.write(0x6B);  
  Wire.write(0);     
  Wire.endTransmission(true);
  
  Serial.begin(9600);

  getStick1Values(MPU1);
  getStick2Values(MPU2);
}


void loop(){
  checkToSing1(stick1X);
  checkToSing2(stick2X);
}
